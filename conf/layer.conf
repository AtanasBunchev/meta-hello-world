## conf/layer.conf
```bitbake
BBPATH .= ":${LAYERDIR}"

BBFILES += "${LAYERDIR}/recipes-*/*/*.bb \
            ${LAYERDIR}/recipes-*/*/*.bbappend"

BBFILE_COLLECTIONS += "meta-hello-world"
BBFILE_PATTERN_meta-hello-world = "^${LAYERDIR}/"
BBFILE_PRIORITY_meta-hello-world = "6"

LAYERDEPENDS_meta-hello-world = "core"
LAYERSERIES_COMPAT_meta-hello-world = "kirkstone"
```
